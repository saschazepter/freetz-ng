## make/libs/libxml2/Config.in
```kconfig
config FREETZ_LIB_libxml2
	bool "libxml2 (libxml2.so)"
	select FREETZ_LIB_libiconv    if FREETZ_TARGET_UCLIBC_0_9_28
	select FREETZ_LIB_libpthread  if FREETZ_TARGET_UCLIBC_HAS_multiple_libs
	select FREETZ_LIB_libm        if FREETZ_TARGET_UCLIBC_HAS_multiple_libs
	select FREETZ_LIB_libz
	default n
	help
		XML toolkit from the GNOME project

if FREETZ_LIB_libxml2

	config FREETZ_LIB_libxml2_WITH_HTML
		bool "Build with HTML support"
		default n
		help
			Adds html parsing capability to libxml2. This increases the size of
			libxml2 by 120kB. Html parsing is required to build libxslt.

	config FREETZ_LIB_libxml2_WITH_RELAXNG
		bool "Build with Relax-NG support"
		default n
		help
			Enables Relax-NG schema validation support (--with-relaxng=yes).
			Relax-NG is an alternative to XML Schema for validating XML documents.
			
			Required by:
			- PHP's DOMDocument::relaxNGValidate() methods
			- Applications using Relax-NG validation
			
			Dependencies:
			- Requires --with-tree=yes (tree manipulation API)
			- Included in --with-schemas=yes (XML Schema support)
			
			Size impact: Adds approximately 50-80 KB to libxml2
			
			Note: Automatically enabled by PHP when DOM support is requested.

endif # FREETZ_LIB_libxml2
```

## make/libs/libzip/Config.in
```kconfig
config FREETZ_LIB_libzip
	bool "libzip (libzip.so)"
	select FREETZ_LIB_libz
	default n
	help
		libzip is a C library for reading, creating, and modifying zip archives.
		It supports encryption, compression, and Zip64 extensions.
```

## make/pkgs/gnu-make/Config.in
```kconfig
config FREETZ_PACKAGE_GNU_MAKE
	bool "GNU Make 4.2.1/4.4.1 (binary only)"
	default n
	help
		Make is a tool which controls the generation of executables and
		other non-source files of a program from the program's source files.

if FREETZ_PACKAGE_GNU_MAKE

	choice
		prompt "Version"
			default FREETZ_PACKAGE_GNU_MAKE_VERSION_CURRENT

		config FREETZ_PACKAGE_GNU_MAKE_VERSION_ABANDON
			bool "4.2.1"
			depends on !FREETZ_TARGET_GCC_4_MIN

		config FREETZ_PACKAGE_GNU_MAKE_VERSION_CURRENT
			bool "4.4.1"
			depends on FREETZ_TARGET_GCC_4_MIN

	endchoice

endif # FREETZ_PACKAGE_GNU_MAKE
```

## make/pkgs/hostapd_cli/Config.in
```kconfig
config FREETZ_PACKAGE_HOSTAPD_CLI
	bool "hostapd_cli 2.7 (control interface client)"
	default n
	help
		Command line client for hostapd control interface.
		Useful to send BSS Transition Management (802.11v)
		and Neighbor Report (802.11k) commands to the running daemon.
```

## make/pkgs/ltrace/Config.in
```kconfig
config FREETZ_PACKAGE_LTRACE
	bool "ltrace 0.7.3checkpoint1-git (binary only) - DEPRECATED"
	default n
	depends on FREETZ_TARGET_GCC_4_7_MIN
	depends on (FREETZ_TARGET_ARCH_ARM && FREETZ_TARGET_ARCH_BE && FREETZ_TARGET_BITS_32)  # no armeb, feel free to fix
	select FREETZ_LIB_libelf
	help
		ltrace - library call tracer

		ltrace is a debugging tool, similar to strace, but it traces library
		calls instead of system calls.
```

## make/pkgs/procps-ng/Config.in
```kconfig
menuconfig FREETZ_PACKAGE_PROCPS_NG
	bool "procps-ng 4.0.4 (binaries only)"
	default n
	help
		procps-ng - /proc filesystem utilities
		
		This package provides the full versions of procps utilities with
		the suffix "-ng" to avoid conflicts with BusyBox versions.
		
		Binaries included:
		  - ps-ng      - process status
		  - top-ng     - display Linux processes
		  - free-ng    - display amount of free and used memory
		  - uptime-ng  - tell how long the system has been running
		  - vmstat-ng  - virtual memory statistics
		  - w-ng       - show who is logged on
		  - pmap-ng    - report memory map of a process
		  - pgrep-ng   - look up processes based on name
		  - pkill-ng   - signal processes based on name
		  - pidof-ng   - find the process ID of a running program
		  - pwdx-ng    - report current working directory of a process
		  - slabtop-ng - display kernel slab cache information
		  - tload-ng   - graphic representation of system load average
		  - watch-ng   - execute a program periodically
		  - skill-ng   - send a signal or report process status
		  - snice-ng   - renice a process
		  - sysctl-ng  - configure kernel parameters at runtime
		  - kill-ng    - terminate a process
		
		Total size: ~400 KB

if FREETZ_PACKAGE_PROCPS_NG

	config FREETZ_PACKAGE_PROCPS_NG_FREE
		bool "free - display memory usage"
		default y
		help
			Display amount of free and used memory in the system.

	config FREETZ_PACKAGE_PROCPS_NG_KILL
		bool "kill - terminate process"
		default n
		help
			Terminate a process by PID.

	config FREETZ_PACKAGE_PROCPS_NG_PGREP
		bool "pgrep - lookup processes by name"
		default n
		help
			Look up processes based on name and other attributes.

	config FREETZ_PACKAGE_PROCPS_NG_PIDOF
		bool "pidof - find process ID"
		default n
		help
			Find the process ID of a running program.

	config FREETZ_PACKAGE_PROCPS_NG_PKILL
		bool "pkill - signal processes by name"
		default n
		help
			Signal processes based on name and other attributes.

	config FREETZ_PACKAGE_PROCPS_NG_PMAP
		bool "pmap - process memory map"
		default n
		help
			Report memory map of a process.

	config FREETZ_PACKAGE_PROCPS_NG_PS
		bool "ps - process status"
		default y
		help
			Report a snapshot of the current processes.

	config FREETZ_PACKAGE_PROCPS_NG_PWDX
		bool "pwdx - current directory of process"
		default n
		help
			Report current working directory of a process.

	config FREETZ_PACKAGE_PROCPS_NG_SKILL
		bool "skill - send signal to processes"
		default n
		help
			Send a signal or report process status.

	config FREETZ_PACKAGE_PROCPS_NG_SLABTOP
		bool "slabtop - kernel slab cache info"
		default n
		help
			Display kernel slab cache information in real time.

	config FREETZ_PACKAGE_PROCPS_NG_SNICE
		bool "snice - renice processes"
		default n
		help
			Renice a process.

	config FREETZ_PACKAGE_PROCPS_NG_SYSCTL
		bool "sysctl - kernel parameters"
		default n
		help
			Configure kernel parameters at runtime.

	config FREETZ_PACKAGE_PROCPS_NG_TLOAD
		bool "tload - graphical load average"
		default n
		help
			Graphic representation of system load average.

	config FREETZ_PACKAGE_PROCPS_NG_TOP
		bool "top - display Linux processes"
		default y
		help
			Display Linux processes in real-time.

	config FREETZ_PACKAGE_PROCPS_NG_UPTIME
		bool "uptime - system uptime"
		default y
		help
			Tell how long the system has been running.

	config FREETZ_PACKAGE_PROCPS_NG_VMSTAT
		bool "vmstat - virtual memory statistics"
		default y
		help
			Report virtual memory statistics.

	config FREETZ_PACKAGE_PROCPS_NG_WATCH
		bool "watch - execute program periodically"
		default n
		help
			Execute a program periodically, showing output fullscreen.

	config FREETZ_PACKAGE_PROCPS_NG_W
		bool "w - show who is logged on"
		default y
		help
			Show who is logged on and what they are doing.

endif # FREETZ_PACKAGE_PROCPS_NG
```
